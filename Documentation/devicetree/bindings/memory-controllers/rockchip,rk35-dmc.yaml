## Documentation/devicetree/bindings/memory-controllers/rockchip,rk35-dmc.yaml
```yaml
# SPDX-License-Identifier: (GPL-2.0-only OR BSD-2-Clause)
# %YAML 1.2
---
$id: http://devicetree.org/schemas/memory-controllers/rockchip,rk35-dmc.yaml#
$schema: http://devicetree.org/meta-schemas/core.yaml#

title: Rockchip rk35xx DMC (Dynamic Memory Controller) device

maintainers:
  - Alexander Warnecke <awarnecke002@hotmail.com>

properties:
  compatible:
    enum:
      - rockchip,rk3568-dmc
      - rockchip,rk3576-dmc
      - rockchip,rk3588-dmc

  clocks:
    items:
      - description: DMC clock

  clock-names:
    items:
      - const: dmc_clk

  devfreq-events:
    $ref: /schemas/types.yaml#/definitions/phandle
    description:
      Node to get DDR loading. Refer to
      Documentation/devicetree/bindings/devfreq/event/rockchip,dfi.yaml.

  interrupts:
    items:
      - description: DCF interrupt

  interrupt-names:
    items:
      - const: complete

  operating-points-v2: true

  center-supply: true

  mem-supply: true

required:
  - compatible
  - clocks
  - clock-names
  - devfreq-events
  - interrupts
  - interrupt-names
  - operating-points-v2
  - center-supply

additionalProperties: false

allOf:
  - if:
      properties:
        compatible:
          contains:
            enum:
              - rockchip,rk3576-dmc
              - rockchip,rk3588-dmc
    then:
      required:
        - mem-supply

examples:
  - |
    #include <dt-bindings/clock/rockchip,rk3588-cru.h>
    #include <dt-bindings/interrupt-controller/arm-gic.h>
    memory-controller {
      compatible = "rockchip,rk3588-dmc";
      clocks = <&scmi_clk SCMI_CLK_DDR>;
      clock-names = "dmc_clk";
      devfreq-events = <&dfi>;
      interrupts = <GIC_SPI 73 IRQ_TYPE_LEVEL_HIGH 0>;
      interrupt-names = "complete";
    };
```
